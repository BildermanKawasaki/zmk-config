## config/west.yml
```yaml
manifest:
  remotes:
    - name: zmkfirmware
      url-base: https://github.com/zmkfirmware
    - name: BildermanKawasaki
      url-base: https://github.com/BildermanKawasaki
    - name: urob
      url-base: https://github.com/urob
  projects:
    - name: zmk
      remote: zmkfirmware
      revision: v0.2
      import: app/west.yml
    - name: zmk-keyboard-TOTEM
      remote: BildermanKawasaki
      revision: main
    - name: zmk-auto-layer
      remote: urob
      revision: main
    - name: zmk-adaptive-key
      remote: urob
      path: modules/zmk/adaptive-key
      revision: main
    - name: zmk-auto-layer
      remote: urob
      path: modules/zmk/auto-layer
      revision: main
    - name: zmk-helpers
      remote: urob
      path: modules/zmk/helpers
      revision: main
    - name: zmk-leader-key
      remote: urob
      path: modules/zmk/leader-key
      revision: main
    - name: zmk-tri-state
      remote: urob
      path: modules/zmk/tri-state
      revision: main
  self:
    path: config
```
